## components/companion_app/Kconfig.projbuild
```kconfig
menu "Companion interaction"

config COMPANION_SMART_VAD
    bool "Enable basic Smart VAD automatic end-of-speech"
    default y
    help
        The button still starts capture. Once speech has been detected, the
        firmware automatically ends the turn after the configured silence.
        Disable this to use manual button stop only.

config COMPANION_VAD_THRESHOLD
    int "Smart VAD mean-absolute PCM threshold"
    range 1 32767
    default 450
    depends on COMPANION_SMART_VAD

config COMPANION_VAD_SILENCE_MS
    int "Smart VAD trailing silence (ms)"
    range 200 3000
    default 800
    depends on COMPANION_SMART_VAD

config COMPANION_VAD_MIN_SPEECH_MS
    int "Minimum detected speech before auto-stop (ms)"
    range 0 3000
    default 250
    depends on COMPANION_SMART_VAD

config COMPANION_IDLE_AFTER_MS
    int "Idle clock delay (ms)"
    range 1000 60000
    default 5000

config COMPANION_ALARM_VISIBLE_MS
    int "Alarm screen duration (ms)"
    range 1000 60000
    default 10000

config COMPANION_ALARM_TONE_MS
    int "Local alarm beep pattern duration (ms)"
    range 0 10000
    default 900

endmenu
```

## components/esp32_network/Kconfig.projbuild
```kconfig
menu "Companion network"

config COMPANION_TZ_RULE
    string "POSIX timezone rule for device clock"
    default "ICT-7"

endmenu
```

## components/esp32_ota/Kconfig.projbuild
```kconfig
menu "Companion OTA"

config COMPANION_OTA_BOARD
    string "Immutable Companion board identity for OTA targeting"
    default ""
    help
        Exact board/revision identity expected in signed firmware manifests. Empty
        disables OTA checks fail-safe until a product board identity is configured.

config COMPANION_OTA_CHANNEL
    string "Firmware release channel"
    default "stable"

config COMPANION_OTA_HEALTH_TIMEOUT_MS
    int "Pending-image health timeout (ms)"
    range 30000 300000
    default 120000

endmenu
```

## components/esp32_provisioning/Kconfig.projbuild
```kconfig
menu "Companion secure storage"

config COMPANION_REQUIRE_ENCRYPTED_NVS
    bool "Require pre-provisioned HMAC-backed NVS encryption"
    default n
    help
        Production/manufacturing guard for persisted Wi-Fi and enrolled-device
        credentials. When enabled, the build must also enable NVS encryption
        with the HMAC key-protection scheme. At boot Companion verifies that
        the configured eFuse key block is already provisioned with HMAC_UP
        before nvs_flash_init() is allowed to run. Companion never burns the
        HMAC eFuse key automatically.

config COMPANION_NVS_HMAC_KEY_ID
    int "Companion HMAC eFuse key slot"
    range 0 5
    default 0
    help
        Key slot (KEY0..KEY5) that Companion expects manufacturing to have
        provisioned with purpose HMAC_UP. This value is compiled in all builds
        so the preflight code stays build-covered, but it is enforced only when
        COMPANION_REQUIRE_ENCRYPTED_NVS is enabled. In secure mode it must equal
        CONFIG_NVS_SEC_HMAC_EFUSE_KEY_ID.

endmenu
```
